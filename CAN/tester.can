/*@!Encoding:1250*/
includes
{
  
}

variables
{
  int session;
  msTimer diag_ses;
  message msgTx T;
}

on start
{
  Write("Tester module started.");
  session = 0;
}

on message *
{
  if (this.id != @ID_out || this.dlc != 8)
    return;
  
  @out0 = this.byte(0);
  @out1 = this.byte(1);
  @out2 = this.byte(2);
  @out3 = this.byte(3);
  @out4 = this.byte(4);
  @out5 = this.byte(5);
  @out6 = this.byte(6);
  @out7 = this.byte(7);
}

on envVar send
{
  if (getValue(send))
    return;
  
  T.ID = @ID_in;
  T.DLC = 8;
 
  T.byte0 = @in0;
  T.byte1 = @in1;
  T.byte2 = @in2;
  T.byte3 = @in3;
  T.byte4 = @in4;
  T.byte5 = @in5;
  T.byte6 = @in6;
  T.byte7 = @in7;
  
  output(T);
}

on envVar start_stop
{
  if (getValue(start_stop))
    return;
  
  if (!session)
  {
    Write("Diagnostic session started");
    SetTimer(diag_ses, 100);
    session = 1;
  }
  else
  {
    Write("Diagnostic session stopped");
    cancelTimer(diag_ses);
    session = 0;
  }
}

on timer diag_ses
{
  T.ID = @ID_sus;
  T.DLC = 8;
 
  T.byte0 = @sus0;
  T.byte1 = @sus1;
  T.byte2 = @sus2;
  T.byte3 = @sus3;
  T.byte4 = @sus4;
  T.byte5 = @sus5;
  T.byte6 = @sus6;
  T.byte7 = @sus7;
  
  output(T);
  
  SetTimer(diag_ses, 100);
}