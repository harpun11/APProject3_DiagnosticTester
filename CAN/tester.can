/*@!Encoding:1250*/
includes
{
  
}

variables
{
  int session;
  msTimer diag_ses;
  message msgTx T;
}

on start
{
  Write("Tester module started.");
  session = 0;
}

on message *
{
  //Write("something");
}

on message msg
{
  Write("Message intercepted.");
  
  Write("Message ID: %d", this.id);
  Write("%c%c%c%c%c%c%c%c",this.byte0,this.byte1,this.byte2,this.byte3,this.byte4,this.byte5,this.byte6,this.byte7);
  
  @out0 = this.byte0;
  @out1 = this.byte1;
  @out2 = this.byte2;
  @out3 = this.byte3;
  @out4 = this.byte4;
  @out5 = this.byte5;
  @out6 = this.byte6;
  @out7 = this.byte7;
}

on envVar send
{
  if (getValue(send))
    return;
  
  Write("Messege Tx");
  T.ID = 0x252;
  T.DLC = 8;
 
  T.byte0 = @in0;
  T.byte1 = @in1;
  T.byte2 = @in2;
  T.byte3 = @in3;
  T.byte4 = @in4;
  T.byte5 = @in5;
  T.byte6 = @in6;
  T.byte7 = @in7;
  
  output(T);
}

on envVar start_stop
{
  if (getValue(start_stop))
    return;
  
  if (!session)
  {
    Write("start button");
    SetTimer(diag_ses, 100);
    session = 1;
  }
  else
  {
    Write("stop button");
    cancelTimer(diag_ses);
    session = 0;
  }
}

on timer diag_ses
{
  Write("diagnostic session message sent");
  
  T.ID = 0x252;
  T.DLC = 8;
 
  T.byte0 = @sus0;
  T.byte1 = @sus1;
  T.byte2 = @sus2;
  T.byte3 = @sus3;
  T.byte4 = @sus4;
  T.byte5 = @sus5;
  T.byte6 = @sus6;
  T.byte7 = @sus7;
  
  output(T);
  
  SetTimer(diag_ses, 100);
}